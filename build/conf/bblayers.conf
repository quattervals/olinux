## build/conf/bblayers.conf
```bitbake
# Minimal layer configuration

POKY_BBLAYERS_CONF_VERSION = "2"
BBPATH = "${TOPDIR}"
BBFILES ?= ""

BBLAYERS ?= " \
  ${TOPDIR}/../poky/meta \
  ${TOPDIR}/../poky/meta-poky \
  ${TOPDIR}/../poky/meta-yocto-bsp \
  ${TOPDIR}/../meta-arm/meta-arm \
  ${TOPDIR}/../meta-arm/meta-arm-toolchain \
  ${TOPDIR}/../meta-ti/meta-ti-bsp \
  ${TOPDIR}/../meta-openembedded/meta-oe \
  ${TOPDIR}/../meta-openembedded/meta-python \
  ${TOPDIR}/../meta-openembedded/meta-networking \
  ${TOPDIR}/../meta-lts-mixins \
  ${TOPDIR}/../meta-custom \
  "
```

## meta-custom/conf/distro/beaglebone-distro.conf
```bitbake
require conf/distro/poky.conf

DISTRO = "beaglebone-distro"
DISTRO_NAME = "BeagleBone Black Distribution"
DISTRO_VERSION = "1.0"

# Enable systemd and required features
DISTRO_FEATURES:append = " systemd usrmerge"
DISTRO_FEATURES_BACKFILL_CONSIDERED += "sysvinit"

# Use systemd as init system
VIRTUAL-RUNTIME_init_manager = "systemd"
# VIRTUAL-RUNTIME_initscripts = "systemd-compat-units"

# Enable Rust in this specific version
DISTRO_FEATURES:append = " rust"
RUST_VERSION = "1.85.1"
CARGO_VERSION = "1.85.1"


IMAGE_BOOT_FILES += "devicetree/*.dtbo;overlays/"
IMAGE_BOOT_FILES += "extlinux/extlinux.conf;extlinux/"
```
