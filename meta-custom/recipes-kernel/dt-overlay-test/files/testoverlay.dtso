/dts-v1/;
/plugin/;
/ {
	// compatible = "brcm,bcm2835";
	compatible = "ti,am335x-bone", "ti,am33xx";
	fragment@0 {
		// target = <&i2c2>;
		// target-path = "/ocp/interconnect@48000000/segment@100000/target-module@9c000/i2c@0";
		target = <0xbb>;  // Use the phandle of the i2c2 node
		__overlay__ {
			#address-cells = <1>;
			#size-cells = <0>;

			my_adc: my_adc@44 {
				compatible = "brightlight,myadc";
				reg = <0x44>;
				status = "okay";
			};
		};
	};
};
