/dts-v1/;
/plugin/;
/ {
	// compatible = "brcm,bcm2835";
	compatible = "ti,beaglebone", "ti,beaglebone-black";
	fragment@0 {
		target = <&i2c2>;
		__overlay__ {
			#address-cells = <1>;
			#size-cells = <0>;

			my_adc: my_adc@44 {
				compatible = "brightlight,myadc";
				reg = <0x44>;
				status = "okay";
			};
		};
	};
};
